## esp32/components/player/Kconfig.projbuild
```kconfig
menu "Player Configuration"

    config AUDIO_SAMPLE_RATE
        int "The audio sample rate (Unit: Hz)"
        default 31250
        help
            The audio sample rate

    choice PLAYER_BACKEND
        prompt "Player backend"
        default PLAYER_I2S
        help
            Use DAC or I2S for sound output

        config PLAYER_DAC
            bool "Play though DAC"
            help
                Use DAC for sound output.

        config PLAYER_I2S
            bool "Play through I2S"
            depends on SOC_I2S_SUPPORTS_PDM_TX
            help
                Use I2S for sound output.
    endchoice

endmenu
```

## esp32/components/storage/Kconfig.projbuild
```kconfig
menu "Storage Configuration"

    config MOUNT_POINT
        string "Storage mount point"
        default "/decoder"
        help
            Mount point for project storage media

    choice STORAGE_BACKEND
        prompt "Storage backend"
        default STORAGE_FLASH
        help
            Use internal flash or SD for sound project storage

        config STORAGE_SD
            bool "Store files on SD"
            help
                Use SD for sound project.

        config STORAGE_FLASH
            bool "Store files in internal flash"
            help
                Use internal flash for sound project.
    endchoice
endmenu
```
